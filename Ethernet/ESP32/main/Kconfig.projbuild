## Ethernet/ESP32/main/Kconfig.projbuild
```kconfig
menu "Example Configuration"

    choice DATARATE
        prompt "WiFi datarate"
        default DATARATE_24
        help
            WiFi datarate.

        config DATARATE_6
            bool "6 MBps"
        config DATARATE_9
            bool "9 MBps"
        config DATARATE_12
            bool "12 MBps"
        config DATARATE_18
            bool "18 MBps"
        config DATARATE_24
            bool "24 MBps"
        config DATARATE_36
            bool "36 MBps"
        config DATARATE_48
            bool "48 MBps"
        config DATARATE_56
            bool "56 MBps"
    endchoice

    config BATCH_SIZE
        int "Packet batch size"
        range 1 10000000
        default 1000
        help
            Number of packets that will be test to measure (on average) what we want.

    config DATA_LEN
        int "Test data length"
        default 127
        range 0 255
        help
            Length of the data that will be send to test round trip time.

    menu "Histogram Config"

        config HISTO_INF
            int "Lower bound (us)"
            default 0
            help
                Minimum of the histogram range (in us).
                /!\ Must be lower than Upper bound.

        config HISTO_SUP
            int "Upper bound (us)"
            default 10000
            help
                Minimum of the histogram range (in us).
                /!\ Must be greater than Lower bound.

        config HISTO_N_STEP
            int "Bucket number"
            default 100
            help
                Number of buckets (a.k.a sub-ranges) in which the main range will be divided into.
    endmenu

endmenu
```
